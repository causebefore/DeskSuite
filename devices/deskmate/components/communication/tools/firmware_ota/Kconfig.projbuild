## devices/deskmate/main/Kconfig.projbuild
```kconfig
menu "DeskMate Power"

config DESKMATE_LIGHT_SLEEP_ENABLED
    bool "Enable light sleep"
    default y
    depends on !DESKMATE_WAKE_WORD_ENABLE
    help
        启用后，设备在用户无活动窗口结束且产品事务空闲时进入不复位芯片的
        Light-sleep。UI 会可逆停止；左右按键恢复交互，内部 Timer 负责刷新一次屏幕。
        WakeNet 常驻监听启用时自动禁用本功能，因为 CPU 轻睡后无法继续处理麦克风数据。

config DESKMATE_LIGHT_SLEEP_IDLE_TIMEOUT_SEC
    int "Light sleep idle timeout (seconds)"
    default 30
    range 10 3600
    help
        最后一次产品活动后保持唤醒的时间，默认 30 秒。

config DESKMATE_LIGHT_SLEEP_RETRY_DELAY_MS
    int "Light sleep retry delay (ms)"
    default 10000
    range 1000 60000
    help
        语音、音频、OTA、实时网络租约或按键暂时阻止睡眠时，再次检查前的等待时间。

config DESKMATE_LIGHT_SLEEP_REFRESH_INTERVAL_SEC
    int "Light sleep screen refresh interval (seconds)"
    default 60
    range 10 3600
    depends on DESKMATE_LIGHT_SLEEP_ENABLED
    help
        进入 Light-sleep 后，ESP32 内部 Timer 周期唤醒的间隔。每次 Timer 唤醒
        会恢复 UI、同步刷新一次屏幕，再次停止 UI 并继续睡眠；默认 60 秒。

endmenu

menu "DeskMate Server"

config DESKMATE_SERVER_URL
    string "DeskMate server base URL"
    default "http://192.168.6.13:8765"
    help
        本地 FastAPI server 地址，例如 http://192.168.1.10:8765。
        设备也可以通过配网页保存 service_url 覆盖此默认值。

config DESKMATE_OTA_DEFAULT_ENABLED
    bool "Enable OTA auto check by default"
    default y
    help
        是否默认启用 OTA 自动检查。

config DESKMATE_OTA_CHECK_INTERVAL_SEC
    int "OTA auto check interval in seconds"
    default 1800
    range 5 86400
    help
        OTA 自动检查的时间间隔，单位为秒。

config DESKMATE_OTA_AUTO_INSTALL
    bool "Automatically install firmware updates"
    default y
    help
        OTA 实测阶段打开。关闭时只自动检查并记录发现的新版本。

endmenu

menu "DeskMate Voice"

config DESKMATE_WAKE_WORD_ENABLE
    bool "Enable WakeNet wake-word listener"
    default n
    select SR_WN_WN9_NIHAOXIAOZHI_TTS
    help
        启用后麦克风输入和 AFE 会在空闲时常驻，用于检测“你好小智”唤醒词。
        默认关闭以降低空闲功耗；右键长按语音对话不受影响。

endmenu

menu "DeskMate Time"

config DESKMATE_TIME_SNTP_ENABLED
    bool "Enable SNTP network time sync"
    default y
    help
        启用后，设备在 STA 联网成功时启动 SNTP 校时，并按配置周期重同步。

config DESKMATE_TIME_SNTP_PRIMARY_SERVER
    string "Primary NTP server"
    default "ntp.aliyun.com"

config DESKMATE_TIME_SNTP_SYNC_INTERVAL_SEC
    int "SNTP sync interval in seconds"
    default 86400
    range 3600 604800
    help
        默认 86400 秒，即每天重同步一次系统时间。联网恢复时也会主动触发一次校时。

endmenu

menu "DeskMate Network Application"

config DESKMATE_WIFI_RECONNECT_BACKOFF_MIN_MS
    int "Wi-Fi reconnect backoff start (ms)"
    default 30000
    range 1000 300000
    help
        快速重试全失败后，指数退避的起始间隔，单位毫秒。

config DESKMATE_WIFI_RECONNECT_BACKOFF_MAX_MS
    int "Wi-Fi reconnect backoff cap (ms)"
    default 300000
    range 10000 1800000
    help
        指数退避封顶间隔，单位毫秒。

config DESKMATE_API_HTTP_TIMEOUT_MS
    int "Device API HTTP timeout (ms)"
    default 30000
    range 1000 120000
    help
        所有设备 API 请求（dashboard/register/events/settings 等）的 HTTP 超时。

config DESKMATE_API_SYNC_RETRY_MAX
    int "Dashboard first-sync retry count"
    default 3
    range 0 10
    help
        dashboard 首次同步失败时的线性退避重试次数。

config DESKMATE_API_SYNC_RETRY_DELAY_MS
    int "Dashboard sync retry backoff base (ms)"
    default 5000
    range 500 60000
    help
        同步重试退避基数（× attempt），单位毫秒。

config DESKMATE_DASHBOARD_FAILURE_RETRY_SEC
    int "Dashboard first failure retry interval in seconds"
    default 60
    range 10 3600
    help
        Dashboard 完整同步重试仍失败后的第一档本地退避间隔。连续失败依次使用
        1、5、15、60 倍间隔并在最后一档封顶；任意一次成功同步后回到第一档。
        成功场景只使用服务端 next_refresh_at_utc，不使用本地相对刷新周期。

config DESKMATE_API_DASHBOARD_JSON_MAX
    int "Dashboard response JSON buffer cap (bytes)"
    default 12288
    range 4096 12288
    help
        Dashboard schema 3 原始 JSON 的堆缓冲上限；协议硬上限为 12288 字节。

config DESKMATE_OTA_HTTP_TIMEOUT_MS
    int "OTA HTTP timeout (ms)"
    default 8000
    range 2000 60000
    help
        OTA check 与固件下载的 HTTP 超时，单位毫秒。

config DESKMATE_WEB_CONSOLE_NETWORK_WAIT_MS
    int "Web console network wait timeout (ms)"
    default 20000
    range 1000 120000
    help
        网页控制台启动前等待网络 ONLINE 的最长时间，单位毫秒。
        需覆盖唤醒重连与上线后 Dashboard 同步占用网络任务的窗口。

config DESKMATE_SETTINGS_NAMESPACE
    string "NVS namespace"
    default "deskmate"
    help
        设备持久化使用的 NVS 命名空间。

endmenu

menu "DeskMate Key"

config DESKMATE_KEY_DEBOUNCE_MS
    int "Button debounce time (ms)"
    default 30
    range 5 200
    help
        按键防抖时间，单位毫秒。

config DESKMATE_KEY_LONG_PRESS_MS
    int "Button long-press threshold (ms)"
    default 700
    range 200 5000
    help
        按键长按判定阈值，单位毫秒。

config DESKMATE_KEY_POLL_PERIOD_MS
    int "Button poll period (ms)"
    default 10
    range 5 100
    help
        按键状态轮询周期，单位毫秒（esp_timer 以 µs 启动，代码内 ×1000）。

endmenu

menu "DeskMate Audio/Voice"

config DESKMATE_AUDIO_SAMPLE_RATE_HZ
    int "I2S hardware sample rate (Hz)"
    default 24000
    range 16000 48000
    help
        ES8311 输出与 ES7210 输入共享 I2S 时钟，因此使用同一硬件采样率。

config DESKMATE_AUDIO_DEFAULT_VOLUME
    int "Default output volume (0-100)"
    default 50
    range 0 100
    help
        Audio Service 初始化时传给 Device 的默认扬声器音量。

config DESKMATE_AUDIO_DEFAULT_GAIN_DB
    int "Default ES7210 microphone gain (dB)"
    default 30
    range 0 48
    help
        Audio Service 初始化时传给 Device 的 ES7210 麦克风增益。

config DESKMATE_VOICE_HTTP_TIMEOUT_MS
    int "Voice HTTP total timeout (ms)"
    default 30000
    range 5000 120000
    help
        语音对话 HTTP 总超时（覆盖 ASR + TTS 流式），单位毫秒。

config DESKMATE_VOICE_VAD_LEAD_TIMEOUT_MS
    int "Voice VAD lead timeout (ms)"
    default 3000
    range 500 30000
    help
        语音开始后多久无人声即放弃，单位毫秒。

config DESKMATE_VOICE_FOLLOWUP_TIMEOUT_MS
    int "Voice follow-up wait timeout (ms)"
    default 5000
    range 1000 10000
    help
        每轮回复完整播放后，等待下一句有效人声的最长时间；超时后正常结束连续会话。

config DESKMATE_VOICE_VAD_SILENCE_END_MS
    int "Voice VAD trailing silence (ms)"
    default 1200
    range 200 5000
    help
        判定一句话结束的尾端静音时长，单位毫秒。

config DESKMATE_VOICE_VAD_WAKE_GUARD_MS
    int "Voice wake-word tail guard window (ms)"
    default 500
    range 0 3000
    help
        唤醒词尾音保护窗，避免尾音被截断，单位毫秒。

config DESKMATE_VOICE_WS_CONNECT_TIMEOUT_MS
    int "Voice WebSocket connect timeout (ms)"
    default 5000
    range 1000 30000
    help
        语音 WebSocket 连接超时，单位毫秒。

config DESKMATE_VOICE_WS_IDLE_TIMEOUT_MS
    int "Voice WebSocket idle timeout (ms)"
    default 30000
    range 5000 120000
    help
        语音 WebSocket 空闲超时，单位毫秒。

config DESKMATE_VOICE_WS_RX_QUEUE_LEN
    int "Voice WebSocket rx queue depth"
    default 64
    range 8 256
    help
        WebSocket 接收队列深度。

config DESKMATE_VOICE_WS_BUFFER_SIZE
    int "Voice WebSocket receive buffer (bytes)"
    default 24576
    range 4096 65536
    help
        WebSocket 接收缓冲大小。

config DESKMATE_VOICE_WS_UPLOAD_CHUNK_BYTES
    int "Voice WebSocket upload chunk (bytes)"
    default 4096
    range 512 16384
    help
        WebSocket 上传分片字节数。

config DESKMATE_AUDIO_PCM_STREAM_BYTES
    int "Audio PCM stream buffer (bytes)"
    default 262144
    range 65536 524288
    help
        Audio Service 唯一 PCM 播放 StreamBuffer 大小（PSRAM），默认 256*1024。

config DESKMATE_VOICE_CHAT_DURATION_MS
    int "Voice single chat duration (ms)"
    default 8000
    range 2000 10000
    help
        单次语音对话时长上限，单位毫秒。

config DESKMATE_VOICE_WAKE_COOLDOWN_MS
    int "Wake-word cooldown (ms)"
    default 2000
    range 0 30000
    help
        唤醒词触发后的冷却去抖时间，单位毫秒。

config DESKMATE_AUDIO_SPEECH_MIN_MS
    int "Capture speech minimum duration (ms)"
    default 200
    range 50 2000
    help
        采集中判定为"有效人声"的最短时长，单位毫秒。

config DESKMATE_AUDIO_DRAIN_MAX_WAIT_MS
    int "AFE drain max wait on stop (ms)"
    default 300
    range 50 5000
    help
        AFE 停止时 drain 的最长等待，单位毫秒。

endmenu

menu "DeskMate Display"

config DESKMATE_DISPLAY_PARTIAL_FLUSH
    bool "Enable partial flush"
    default y
    help
        局部刷新开关。脏区占比超过阈值时退化为全屏刷新。

config DESKMATE_DISPLAY_PARTIAL_FULL_PERCENT
    int "Partial flush -> full flush dirty ratio (%)"
    default 70
    range 20 100
    help
        脏区占 framebuffer 的百分比超过此值时，退化为全屏刷新。

config DESKMATE_DISPLAY_TE_SYNC
    bool "Enable TE (tearing-effect) sync"
    default y
    help
        撕裂效应同步开关。连续多次 TE 超时会自动关闭。

config DESKMATE_DISPLAY_TE_WAIT_TIMEOUT_MS
    int "TE signal wait timeout (ms)"
    default 60
    range 5 1000
    help
        等待 TE 信号的超时，单位毫秒。

config DESKMATE_DISPLAY_TE_MAX_TIMEOUTS
    int "TE max consecutive timeouts before auto-disable"
    default 5
    range 1 50
    help
        连续 TE 超时达到此次数后自动关闭 TE 同步。

config DESKMATE_DISPLAY_I1_INVERT
    bool "Invert I1 pixel polarity"
    default n
    help
        I1 像素反相（显示极性开关）。

config DESKMATE_UI_PAGE_ENTER_ANIM_MS
    int "Page enter animation duration (ms)"
    default 200
    range 0 2000
    help
        页面进入滑入动画时长，单位毫秒。

config DESKMATE_UI_SETTINGS_RESULT_AUTO_RETURN_MS
    int "Settings result auto return (ms)"
    default 3000
    range 500 30000
    help
        设置菜单中“无更新”和“检查失败”结果自动返回根菜单的时长，单位毫秒。

config DESKMATE_UI_TASK_STACK_SIZE
    int "UI task stack size (bytes)"
    default 8192
    range 4096 16384
    help
        UI 消息任务的内部 SRAM 栈大小。全屏 LVGL 实刷和字体分区
        mmap/munmap 会在该任务中执行；后者冻结 Cache 时不能使用 PSRAM 栈。
        默认 8KB。

endmenu
```

## devices/deskmate/sdkconfig.defaults
```kconfig
CONFIG_ESPTOOLPY_FLASHSIZE_16MB=y
CONFIG_ESPTOOLPY_FLASHSIZE="16MB"
CONFIG_PARTITION_TABLE_CUSTOM=y
CONFIG_PARTITION_TABLE_CUSTOM_FILENAME="partitions.csv"
CONFIG_PARTITION_TABLE_FILENAME="partitions.csv"
CONFIG_PARTITION_TABLE_OFFSET=0x8000
CONFIG_PARTITION_TABLE_MD5=y
CONFIG_ESP_COREDUMP_ENABLE_TO_FLASH=y
CONFIG_ESP_COREDUMP_DATA_FORMAT_ELF=y
CONFIG_ESP_COREDUMP_CHECKSUM_CRC32=y
CONFIG_ESP_MAIN_TASK_STACK_SIZE=8192
CONFIG_ESP_SYSTEM_EVENT_TASK_STACK_SIZE=4096
CONFIG_COMPILER_OPTIMIZATION_DEBUG=n
CONFIG_COMPILER_OPTIMIZATION_SIZE=y
CONFIG_FREERTOS_HZ=100
CONFIG_LWIP_SNTP_MAX_SERVERS=3
CONFIG_DESKMATE_SERVER_URL="http://192.168.6.248:8765"
CONFIG_CONNECT_PORTAL_SSID="DeskMate-Setup"
CONFIG_CONNECT_PORTAL_PASSWORD="deskmate"
CONFIG_CONNECT_PORTAL_DEFAULT_SERVICE_URL="http://192.168.6.248:8765"
CONFIG_NETWORK_MANAGER_DEFAULT_SERVICE_URL="http://192.168.6.248:8765"
CONFIG_COMMUNICATION_HTTP_TIMING_LOGS=n
CONFIG_COMMUNICATION_TASK_STACK_STATS=y
CONFIG_DESKMATE_OTA_AUTO_INSTALL=y
CONFIG_DESKMATE_OTA_CHECK_INTERVAL_SEC=1800
CONFIG_DESKMATE_WAKE_WORD_ENABLE=n
CONFIG_DESKMATE_LIGHT_SLEEP_ENABLED=y
CONFIG_DESKMATE_LIGHT_SLEEP_IDLE_TIMEOUT_SEC=60
CONFIG_DESKMATE_LIGHT_SLEEP_RETRY_DELAY_MS=10000
CONFIG_DESKMATE_LIGHT_SLEEP_REFRESH_INTERVAL_SEC=60
CONFIG_DESKMATE_RTC_ALARM_MAX_DELAY_SEC=86400
CONFIG_DESKMATE_WIFI_RECONNECT_BACKOFF_MIN_MS=30000
CONFIG_DESKMATE_WIFI_RECONNECT_BACKOFF_MAX_MS=300000
CONFIG_DESKMATE_API_HTTP_TIMEOUT_MS=20000
CONFIG_DESKMATE_API_SYNC_RETRY_MAX=3
CONFIG_DESKMATE_API_SYNC_RETRY_DELAY_MS=5000
CONFIG_DESKMATE_API_DEFAULT_REFRESH_SEC=300
CONFIG_DESKMATE_API_DASHBOARD_JSON_MAX=12288
CONFIG_DESKMATE_OTA_HTTP_TIMEOUT_MS=8000
CONFIG_DESKMATE_DASHBOARD_REFRESH_DEFAULT_SEC=1800
CONFIG_DESKMATE_SETTINGS_NAMESPACE="deskmate"
CONFIG_DESKMATE_INPUT_DEBOUNCE_MS=30
CONFIG_DESKMATE_INPUT_LONG_PRESS_MS=700
CONFIG_DESKMATE_INPUT_POLL_PERIOD_MS=10
CONFIG_DESKMATE_AUDIO_DEFAULT_VOLUME=50
CONFIG_DESKMATE_AUDIO_DEFAULT_GAIN_DB=30
CONFIG_DESKMATE_VOICE_HTTP_TIMEOUT_MS=30000
CONFIG_DESKMATE_VOICE_VAD_LEAD_TIMEOUT_MS=3000
CONFIG_DESKMATE_VOICE_VAD_SILENCE_END_MS=1200
CONFIG_DESKMATE_VOICE_VAD_WAKE_GUARD_MS=500
CONFIG_DESKMATE_VOICE_PLAYBACK_STOP_TIMEOUT_MS=3000
CONFIG_DESKMATE_VOICE_WS_CONNECT_TIMEOUT_MS=5000
CONFIG_DESKMATE_VOICE_WS_IDLE_TIMEOUT_MS=30000
CONFIG_DESKMATE_VOICE_WS_RX_QUEUE_LEN=64
CONFIG_DESKMATE_VOICE_WS_BUFFER_SIZE=24576
CONFIG_DESKMATE_VOICE_WS_UPLOAD_CHUNK_BYTES=4096
CONFIG_DESKMATE_VOICE_PLAY_STREAM_BYTES=262144
CONFIG_DESKMATE_VOICE_CHAT_DURATION_MS=8000
CONFIG_DESKMATE_VOICE_WAKE_COOLDOWN_MS=2000
CONFIG_DESKMATE_AUDIO_SPEECH_MIN_MS=200
CONFIG_DESKMATE_AUDIO_DRAIN_MAX_WAIT_MS=300
CONFIG_DESKMATE_DISPLAY_PARTIAL_FLUSH=y
CONFIG_DESKMATE_DISPLAY_PARTIAL_FULL_PERCENT=70
CONFIG_DESKMATE_DISPLAY_TE_SYNC=y
CONFIG_DESKMATE_DISPLAY_TE_WAIT_TIMEOUT_MS=60
CONFIG_DESKMATE_DISPLAY_TE_MAX_TIMEOUTS=5
CONFIG_DESKMATE_DISPLAY_RGB565_BLACK_THRESHOLD=6368
CONFIG_DESKMATE_DISPLAY_I1_INVERT=n
CONFIG_DESKMATE_DISPLAY_PERF_LOG_INTERVAL_US=5000000
CONFIG_DESKMATE_UI_PAGE_ENTER_ANIM_MS=200
CONFIG_DESKMATE_UI_SETTINGS_RESULT_AUTO_RETURN_MS=3000
CONFIG_DESKMATE_UI_TASK_STACK_SIZE=8192
CONFIG_PM_ENABLE=y

# 网页文件管理：支持 UTF-8 长文件名，并为最坏百分号编码后的路径保留 URI 空间
CONFIG_FATFS_LFN_HEAP=y
CONFIG_FATFS_MAX_LFN=255
CONFIG_FATFS_API_ENCODING_UTF_8=y
# CONFIG_FATFS_API_ENCODING_ANSI_OEM is not set
# CONFIG_HTTPD_WS_SUPPORT is not set
CONFIG_HTTPD_MAX_URI_LEN=2048

# remote_log 通过 Log V2 包装普通 ESP_LOGx 并上传网络日志
CONFIG_LOG_VERSION_2=y
CONFIG_LOG_MODE_TEXT=y


# 外置sram相关配置
CONFIG_SPIRAM=y
CONFIG_SPIRAM_MODE_OCT=y
CONFIG_SPIRAM_USE_MALLOC=y
CONFIG_SPIRAM_MALLOC_ALWAYSINTERNAL=512
CONFIG_SPIRAM_MALLOC_RESERVE_INTERNAL=32768
CONFIG_SPIRAM_TRY_ALLOCATE_WIFI_LWIP=y
CONFIG_SPIRAM_ALLOW_BSS_SEG_EXTERNAL_MEMORY=y

# 低性能内部 SRAM 档：缩小 Data Cache，并把非 Cache-off 必需路径放回 Flash
CONFIG_ESP32S3_DATA_CACHE_16KB=y
CONFIG_ESP32S3_DATA_CACHE_32KB=n
CONFIG_SPI_MASTER_ISR_IN_IRAM=n
CONFIG_SPI_SLAVE_ISR_IN_IRAM=n
CONFIG_GDMA_CTRL_FUNC_IN_IRAM=n
CONFIG_ESP_EVENT_POST_FROM_IRAM_ISR=n
CONFIG_HEAP_PLACE_FUNCTION_INTO_FLASH=y
CONFIG_LIBC_LOCKS_PLACE_IN_IRAM=n

# ESP-IDF v6.0.1 的按任务堆跟踪在 realloc/free 路径存在已知一致性问题，仅保留总量统计
# CONFIG_HEAP_TASK_TRACKING is not set

# mbedTLS 上下文、证书与收发工作内存优先放入 PSRAM，保留内部 RAM 给 DMA 和任务栈
CONFIG_MBEDTLS_EXTERNAL_MEM_ALLOC=y
CONFIG_MBEDTLS_DYNAMIC_BUFFER=y
CONFIG_MBEDTLS_DYNAMIC_FREE_CONFIG_DATA=y
CONFIG_MBEDTLS_DYNAMIC_FREE_CA_CERT=y


# lvgl 相关配置
CONFIG_LV_OS_NONE=y
CONFIG_LV_USE_CLIB_MALLOC=y
CONFIG_LV_USE_CLIB_STRING=y
CONFIG_LV_USE_CLIB_SPRINTF=y
CONFIG_LV_USE_ASSERT_STYLE=y
CONFIG_LV_FONT_FMT_TXT_LARGE=y
CONFIG_LV_USE_QRCODE=y
CONFIG_LV_USE_ANIMIMG=n
CONFIG_LV_USE_CALENDAR=n
CONFIG_LV_USE_CALENDAR_HEADER_ARROW=n
CONFIG_LV_USE_CALENDAR_HEADER_DROPDOWN=n
CONFIG_LV_USE_CHART=n
CONFIG_LV_USE_KEYBOARD=n
CONFIG_LV_USE_LED=n
CONFIG_LV_USE_LIST=n
CONFIG_LV_USE_MENU=y
CONFIG_LV_USE_MSGBOX=n
CONFIG_LV_USE_SPAN=n
CONFIG_LV_USE_SPINBOX=n
CONFIG_LV_USE_SPINNER=n
CONFIG_LV_USE_TABVIEW=n
CONFIG_LV_USE_TILEVIEW=n
CONFIG_LV_USE_WIN=n
CONFIG_LV_BUILD_EXAMPLES=n
CONFIG_LV_BUILD_DEMOS=n
CONFIG_LV_DEF_REFR_PERIOD=10
CONFIG_SPIRAM_SPEED_80M=y

# 音频 codec 支持（esp_codec_dev 组件 Kconfig，clean build 时需显式指定）
CONFIG_CODEC_ES8311_SUPPORT=y
CONFIG_CODEC_ES7210_SUPPORT=y

# ESP-SR 声学前端模型（esp-sr 组件 Kconfig）
CONFIG_MODEL_IN_FLASH=y
CONFIG_AFE_INTERFACE_V1=y
CONFIG_SR_NSN_NSNET2=y
CONFIG_SR_VADN_VADNET1_MEDIUM=y
# WiFi 低吞吐内存档：PSRAM 优先分配会强制使用静态 TX，因此降低池数量而不切换动态 TX
CONFIG_ESP_WIFI_STATIC_RX_BUFFER_NUM=4
CONFIG_ESP_WIFI_DYNAMIC_RX_BUFFER_NUM=16
CONFIG_ESP_WIFI_STATIC_TX_BUFFER=y
CONFIG_ESP_WIFI_DYNAMIC_TX_BUFFER=n
CONFIG_ESP_WIFI_STATIC_TX_BUFFER_NUM=4
CONFIG_ESP_WIFI_RX_BA_WIN=4
CONFIG_ESP_WIFI_IRAM_OPT=n
CONFIG_ESP_WIFI_RX_IRAM_OPT=n
```

## devices/photopainter/components/application/content_refresh_app/Kconfig.projbuild
```kconfig
menu "PhotoPainter 内容刷新"

    config PHOTOPAINTER_SNTP_SERVER
        string "SNTP 时间服务器"
        default "pool.ntp.org"
        help
            每轮网络上线后、执行状态上传和照片同步前使用的单个 SNTP 服务器。

    config PHOTOPAINTER_SNTP_TIMEOUT_MS
        int "单个 SNTP 样本超时（毫秒）"
        range 1000 60000
        default 10000
        help
            每个 SNTP 样本的最大等待时间。可信时间跳变超过 6 小时时最多请求两个样本。

endmenu
```
