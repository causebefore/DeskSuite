## devices/photopainter/components/communication/network_manager/Kconfig.projbuild
```kconfig
menu "Network Manager 默认配置"

    config NETWORK_MANAGER_DEFAULT_SSID
        string "默认 Wi-Fi SSID"
        default ""
        help
            首次启动或 NVS 中无网络配置时使用的默认 Wi-Fi 名称。
            留空则不使用默认值，设备将进入配网模式。

    config NETWORK_MANAGER_DEFAULT_PASSWORD
        string "默认 Wi-Fi 密码"
        default ""
        help
            对应默认 SSID 的 Wi-Fi 密码。

    config NETWORK_MANAGER_DEFAULT_SERVICE_URL
        string "默认服务地址"
        default ""
        help
            格式为 host:port，例如 192.168.1.100:8765。
            留空则由配网 Portal 或运行时配置决定。

endmenu
```

## devices/photopainter/sdkconfig.defaults
```kconfig
# ============================================================
# PhotoPainter ESP-IDF 默认配置 (sdkconfig.defaults)
# ============================================================

# --- Flash 配置 ---
# Flash 大小设置为 32MB
CONFIG_ESPTOOLPY_FLASHSIZE_32MB=y

# 主任务栈大小 8KB
CONFIG_ESP_MAIN_TASK_STACK_SIZE=8192

# --- 分区表配置 ---
# 使用自定义分区表（而非默认分区表）
CONFIG_PARTITION_TABLE_CUSTOM=y
# 指定自定义分区表文件路径
CONFIG_PARTITION_TABLE_CUSTOM_FILENAME="partitions.csv"

# --- SPIRAM（外部 PSRAM）配置 ---
# 启用 SPIRAM
CONFIG_SPIRAM=y
# 使用 Octal（八线）模式，带宽更高
CONFIG_SPIRAM_MODE_OCT=y
# SPIRAM 类型自动检测
CONFIG_SPIRAM_TYPE_AUTO=y
# SPIRAM 时钟频率 80MHz
CONFIG_SPIRAM_SPEED_80M=y
# 跳过 SPIRAM 内存测试（加快启动速度）
CONFIG_SPIRAM_MEMTEST=n
# 小于 512 字节的分配优先使用内部 RAM（提高小分配性能）
CONFIG_SPIRAM_MALLOC_ALWAYSINTERNAL=512
# 为内部 RAM 预留 64KB，防止内部内存被耗尽
CONFIG_SPIRAM_MALLOC_RESERVE_INTERNAL=65536

# --- FAT 文件系统配置 ---
# 启用长文件名支持，使用堆内存存储
CONFIG_FATFS_LFN_HEAP=y
# 最大长文件名长度 255 字符
CONFIG_FATFS_MAX_LFN=255
# 文件名编码使用 UTF-8
CONFIG_FATFS_API_ENCODING_UTF_8=y
# 最大同时打开文件数 8
CONFIG_FATFS_FS_LOCK=8
# 启用每文件缓存（提升读写性能）
CONFIG_FATFS_PER_FILE_CACHE=y

# --- 网络默认配置 ---
# SSID 留空时首次启动显示 NO NETWORK，中键长按 3 秒后进入 Portal；仅联调固件填写默认值
CONFIG_NETWORK_MANAGER_DEFAULT_SSID=""
CONFIG_NETWORK_MANAGER_DEFAULT_PASSWORD=""
CONFIG_NETWORK_MANAGER_DEFAULT_SERVICE_URL=""
CONFIG_CONNECT_PORTAL_SSID="PhotoPainter-Setup"
CONFIG_CONNECT_PORTAL_PASSWORD="photopainter"
CONFIG_CONNECT_PORTAL_DEFAULT_SERVICE_URL="192.168.6.248:8765"
CONFIG_COMMUNICATION_HTTP_TIMING_LOGS=y

# --- OTA 升级配置 ---
# 启用 OTA 应用回滚功能（升级失败可自动回退到上一版本）
CONFIG_BOOTLOADER_APP_ROLLBACK_ENABLE=y


# log相关配置
CONFIG_LOG_VERSION_2=y
CONFIG_LOG_MODE_TEXT=y
CONFIG_LOG_TIMESTAMP_SOURCE_SYSTEM_FULL=y
```

## shared/components/communication/connect/Kconfig.projbuild
```kconfig
# 菜单标题保持 ASCII，兼容 esp-sr 在 Windows 上按系统代码页读取 sdkconfig。
menu "Communication - Connect"

    config CONNECT_PORTAL_SSID
        string "Portal 热点名称"
        default "Device-Setup"
        help
            配网 Portal 使用的 Wi-Fi 热点名称，长度必须为 1 至 32 字节。
            产品应在项目级 sdkconfig.defaults 中覆盖该通用默认值。

    config CONNECT_PORTAL_PASSWORD
        string "Portal 热点密码"
        default "configureme"
        help
            配网 Portal 使用的 WPA/WPA2 密码，长度必须为 8 至 63 字节。
            产品应在项目级 sdkconfig.defaults 中覆盖该通用默认值。

    config CONNECT_PORTAL_DEFAULT_SERVICE_URL
        string "Portal 默认服务地址"
        default ""
        help
            配网 Portal 表单中「服务地址」字段的默认值。
            可以填写完整 http(s) URL，也可以填写 host:port，例如
            http://192.168.1.100:8765 或 192.168.1.100:8765。
            留空则 Portal 表单该字段为空，等待用户手动填写。

endmenu
```

## shared/components/communication/network_manager/Kconfig.projbuild
```kconfig
# 菜单标题保持 ASCII，兼容 esp-sr 在 Windows 上按系统代码页读取 sdkconfig。
menu "Communication - Network Manager"

    config NETWORK_MANAGER_DEFAULT_SSID
        string "默认 Wi-Fi SSID"
        default ""
        help
            首次启动或 NVS 中无网络配置时使用的默认 Wi-Fi 名称。
            留空则不使用默认值，设备将进入配网模式。

    config NETWORK_MANAGER_DEFAULT_PASSWORD
        string "默认 Wi-Fi 密码"
        default ""
        help
            对应默认 SSID 的 Wi-Fi 密码。

    config NETWORK_MANAGER_DEFAULT_SERVICE_URL
        string "默认服务地址"
        default ""
        help
            可以填写完整 http(s) URL，也可以填写 host:port，例如
            http://192.168.1.100:8765 或 192.168.1.100:8765。
            留空则由配网 Portal 或运行时配置决定。

endmenu
```

## shared/components/communication/transport/Kconfig.projbuild
```kconfig
menu "Communication - Transport"

    config COMMUNICATION_HTTP_TIMING_LOGS
        bool "输出缓冲式 HTTP 请求分阶段耗时"
        default n
        help
            输出总耗时、建连、发送、首包等待和响应接收耗时。
            该开关只影响诊断日志，不改变 HTTP 传输行为。

endmenu
```

## shared/components/services/web_console_service/Kconfig
```kconfig
menu "Web Console Service"

    config WEB_CONSOLE_FILES
        bool "Enable Web Console Files module"
        default y
        help
            Enable authenticated file listing, transfer and mutation routes.
            Disable this option to omit Files routes and web assets while
            keeping the Console Core homepage, session and capability routes.

    config WEB_CONSOLE_SETTINGS
        bool "Enable Web Console Settings module"
        default n
        help
            Enable authenticated, versioned Settings Provider discovery,
            snapshot, update and asynchronous result routes. Product owners
            must still explicitly assemble Providers at initialization.

    config WEB_CONSOLE_STATUS
        bool "Enable Web Console Status module"
        default n
        help
            Enable authenticated read-only Status Provider discovery and
            snapshot routes. Product owners must still explicitly assemble
            Providers at initialization.

    config WEB_CONSOLE_ACTIONS
        bool "Enable Web Console Actions module"
        default n
        help
            Enable authenticated discovery, bounded asynchronous submission
            and result routes for explicitly assembled non-destructive device
            management Actions.

endmenu
```

## shared/examples/standalone/sdkconfig.defaults
```kconfig
# remote_log 组件要求 Log V2 文本模式
CONFIG_LOG_VERSION_2=y
CONFIG_LOG_MODE_TEXT=y

# 打开 Web Console 全部可裁剪模块，最大化示例的编译覆盖面
CONFIG_WEB_CONSOLE_FILES=y
CONFIG_WEB_CONSOLE_SETTINGS=y
CONFIG_WEB_CONSOLE_STATUS=y
CONFIG_WEB_CONSOLE_ACTIONS=y
```
